/* USER CODE BEGIN Header */
/**
  ******************************************************************************
  * @file           : main.c
  * @brief          : Main program body
  ******************************************************************************
  * @attention
  *
  * <h2><center>&copy; Copyright (c) 2019 STMicroelectronics.
  * All rights reserved.</center></h2>
  *
  * This software component is licensed by ST under BSD 3-Clause license,
  * the "License"; You may not use this file except in compliance with the
  * License. You may obtain a copy of the License at:
  *                        opensource.org/licenses/BSD-3-Clause
  *
  ******************************************************************************
  */
/* USER CODE END Header */

/* Includes ------------------------------------------------------------------*/
#include "main.h"
#include "usart.h"
#include "gpio.h"

/* Private includes ----------------------------------------------------------*/
/* USER CODE BEGIN Includes */
#include "gpib_io.h"
#include "string.h"
#include "stdlib.h"
#include "shell.h"
#include "shell_ext.h"
/* USER CODE END Includes */

/* Private typedef -----------------------------------------------------------*/
/* USER CODE BEGIN PTD */

/* USER CODE END PTD */

/* Private define ------------------------------------------------------------*/
/* USER CODE BEGIN PD */

/* USER CODE END PD */

/* Private macro -------------------------------------------------------------*/
/* USER CODE BEGIN PM */

/* USER CODE END PM */

/* Private variables ---------------------------------------------------------*/

/* USER CODE BEGIN PV */

/* USER CODE END PV */

/* Private function prototypes -----------------------------------------------*/
void SystemClock_Config(void);
/* USER CODE BEGIN PFP */

/* USER CODE END PFP */

/* Private user code ---------------------------------------------------------*/
/* USER CODE BEGIN 0 */


/**
  * @brief  us的延时，就直接死等
  * @param  nTime：多少个us
  * @retval None
  */
void delay_us(uint32_t nTime)
{
	uint32_t i;
	while(nTime)
	{
		nTime--;
		i=12;     //在48MHz下经过逻辑分析仪校准好的
		while(i)
		{
			i--;
		}
	}
}



/**
 * @brief 向GPIB设备写
 *
 */
int shell_gpib_write(int argc, char *argv[])
{
	char buf[128];
	int res = 0;
    SHELL_TypeDef *shell = shellGetCurrent();
    if (!shell)
    {
        return -1;
    }
	do{
		if(3 > argc)
		{
			shellDisplay(shell, "parameter error");
			res = -2;
			break;
		}
		memset(buf,0,sizeof(buf));
		for(uint8_t i=2;i<argc;i++)
		{
			strcat(buf, argv[i]);
			strcat(buf, " ");
		}
		int32_t addr = atoi(argv[1]);
		if((addr>30) || (addr<1))
		{
			shellDisplay(shell, "addr error");
			res = -3;
			break;
		}
		gpib_cmd(addr, 0); // talker, it's me.
		uint8_t len = strlen(buf);
		gpib_write(buf, len, GPIB_WRITE_USE_EOI);

	}while(0);
	return res;
}
SHELL_EXPORT_CMD_EX(wrt, shell_gpib_write, write to GPIB device, usage wrt <addr> <command>);


/**
 * @brief 测试GPIB设备读写稳定性
 *
 */
int shell_gpib_wrtest(int argc, char *argv[])
{
	int res = 0;
    SHELL_TypeDef *shell = shellGetCurrent();
    if (!shell)
    {
        return -1;
    }
	do{
		if((5 < argc)||(3 > argc))
		{
			shellDisplay(shell, "parameter error");
			res = -2;
			break;
		}
		int32_t addr = atoi(argv[1]);
		if((addr>30) || (addr<1))
		{
			shellDisplay(shell, "addr error");
			res = -3;
			break;
		}

		uint32_t count=10,interval=10;
		if(3 < argc)
		{
			for(uint8_t i=2;i<argc-1;i++)
			{
				char *p = strstr(argv[i], "--time=");
				if(NULL != p)
				{
					p = p+7;
					interval = atoi(p);
				}
				p = strstr(argv[i], "--count=");
				if(NULL != p)
				{
					p = p+8;
					count = atoi(p);
				}
			}
		}
		char buf[64];
		uint32_t cnt=0,cnt_fail=0;
		while(count--)
		{
			cnt++;
			if(0 != gpib_cmd(addr, 0)) // talker, it's me.
			{
				cnt_fail++;
				continue;
			}
			uint8_t len = strlen(argv[argc-1]);
			if(len != gpib_write(argv[argc-1], len, GPIB_WRITE_USE_EOI))
			{
				cnt_fail++;
				continue;
			}

			HAL_Delay(30);

			memset(buf, 0, sizeof(buf));
			if(0 != gpib_cmd(0, addr))// listener, it's me.
			{
				cnt_fail++;
				continue;
			}
			len = gpib_read(buf, GPIB_READ_UNTIL_EOI);
			if(0 == len)
			{
				cnt_fail++;
				continue;
			}
			if(0x0a == buf[len-1])
			{
				buf[len-1] = '\0';
			}
			shellPrint(shell, "count:%u - %s\r\n", cnt, buf);
			HAL_Delay(interval);
		}
		shellPrint(shell, "test failed : %u\r\n", cnt_fail);
		shellPrint(shell, "Yield       : %f\r\n", (float)(cnt-cnt_fail)/(float)cnt);
	}while(0);
	return res;
}
SHELL_EXPORT_CMD_EX(test, shell_gpib_wrtest, test the GPIB device write and read, usage test <addr> [options] <command>\r\n
--time   the interval time of two test\r\n
--count  the number of test times);

/**
 * @brief 从GPIB设备读
 *
 */
int shell_gpib_read(int argc, char *argv[])
{
	int res = 0;
	static char buf[64];
	uint8_t len;
    SHELL_TypeDef *shell = shellGetCurrent();
    if (!shell)
    {
        return -1;
    }
	do{
		if(2 != argc)
		{
			shellDisplay(shell, "parameter error");
			res = -2;
			break;
		}
		int32_t addr = atoi(argv[1]);
		if((addr>30) || (addr<1))
		{
			shellDisplay(shell, "addr error");
			res = -3;
			break;
		}
		memset(buf, 0, sizeof(buf));
		gpib_cmd(0, addr);// listener, it's me.
		len = gpib_read(buf, GPIB_READ_UNTIL_EOI);
		shellPrint(shell, "#%02u:%s", len, buf);
	}while(0);
	return res;

}
SHELL_EXPORT_CMD_EX(rd, shell_gpib_read, read from GPIB device, usage rd <addr>);


/* USER CODE END 0 */

/**
  * @brief  The application entry point.
  * @retval int
  */
int main(void)
{
  /* USER CODE BEGIN 1 */

  /* USER CODE END 1 */


  /* MCU Configuration--------------------------------------------------------*/

  /* Reset of all peripherals, Initializes the Flash interface and the Systick. */
  HAL_Init();

  /* USER CODE BEGIN Init */

  /* USER CODE END Init */

  /* Configure the system clock */
  SystemClock_Config();

  /* USER CODE BEGIN SysInit */
	SEGGER_RTT_Init();
	SYS_UsrLog("system start\r\n");
	SYS_UsrLog("complie time %s\r\n", __TIME__);
  /* USER CODE END SysInit */

  /* Initialize all configured peripherals */
  MX_GPIO_Init();
  MX_USART1_UART_Init();
  /* USER CODE BEGIN 2 */
	LL_GPIO_SetOutputPin(LED_T_GPIO_Port, LED_T_Pin);
	LL_GPIO_SetOutputPin(LED_L_GPIO_Port, LED_L_Pin);
	LL_GPIO_SetOutputPin(LED_RUN_GPIO_Port, LED_RUN_Pin);
	gpib_io_init();
	shell_init();
	LL_GPIO_ResetOutputPin(LED_T_GPIO_Port, LED_T_Pin);
	LL_GPIO_ResetOutputPin(LED_L_GPIO_Port, LED_L_Pin);
  /* USER CODE END 2 */

  /* Infinite loop */
  /* USER CODE BEGIN WHILE */
	while (1)
	{
		shell_exec();  //全部依靠shell控制

    /* USER CODE END WHILE */

    /* USER CODE BEGIN 3 */
	}
  /* USER CODE END 3 */
}

/**
  * @brief System Clock Configuration
  * @retval None
  */
void SystemClock_Config(void)
{
  RCC_OscInitTypeDef RCC_OscInitStruct = {0};
  RCC_ClkInitTypeDef RCC_ClkInitStruct = {0};
  RCC_PeriphCLKInitTypeDef PeriphClkInit = {0};

  /** Initializes the CPU, AHB and APB busses clocks
  */
  RCC_OscInitStruct.OscillatorType = RCC_OSCILLATORTYPE_HSI;
  RCC_OscInitStruct.HSIState = RCC_HSI_ON;
  RCC_OscInitStruct.HSICalibrationValue = RCC_HSICALIBRATION_DEFAULT;
  RCC_OscInitStruct.PLL.PLLState = RCC_PLL_ON;
  RCC_OscInitStruct.PLL.PLLSource = RCC_PLLSOURCE_HSI;
  RCC_OscInitStruct.PLL.PLLMUL = RCC_PLL_MUL12;
  RCC_OscInitStruct.PLL.PREDIV = RCC_PREDIV_DIV1;
  if (HAL_RCC_OscConfig(&RCC_OscInitStruct) != HAL_OK)
  {
    Error_Handler();
  }
  /** Initializes the CPU, AHB and APB busses clocks
  */
  RCC_ClkInitStruct.ClockType = RCC_CLOCKTYPE_HCLK|RCC_CLOCKTYPE_SYSCLK
                              |RCC_CLOCKTYPE_PCLK1;
  RCC_ClkInitStruct.SYSCLKSource = RCC_SYSCLKSOURCE_PLLCLK;
  RCC_ClkInitStruct.AHBCLKDivider = RCC_SYSCLK_DIV1;
  RCC_ClkInitStruct.APB1CLKDivider = RCC_HCLK_DIV1;

  if (HAL_RCC_ClockConfig(&RCC_ClkInitStruct, FLASH_LATENCY_1) != HAL_OK)
  {
    Error_Handler();
  }
  PeriphClkInit.PeriphClockSelection = RCC_PERIPHCLK_USART1;
  PeriphClkInit.Usart1ClockSelection = RCC_USART1CLKSOURCE_PCLK1;
  if (HAL_RCCEx_PeriphCLKConfig(&PeriphClkInit) != HAL_OK)
  {
    Error_Handler();
  }
}

/* USER CODE BEGIN 4 */

/* USER CODE END 4 */

/**
  * @brief  This function is executed in case of error occurrence.
  * @retval None
  */
void Error_Handler(void)
{
  /* USER CODE BEGIN Error_Handler_Debug */
  /* User can add his own implementation to report the HAL error return state */

  /* USER CODE END Error_Handler_Debug */
}

#ifdef  USE_FULL_ASSERT
/**
  * @brief  Reports the name of the source file and the source line number
  *         where the assert_param error has occurred.
  * @param  file: pointer to the source file name
  * @param  line: assert_param error line source number
  * @retval None
  */
void assert_failed(char *file, uint32_t line)
{
  /* USER CODE BEGIN 6 */
  /* User can add his own implementation to report the file name and line number,
     tex: printf("Wrong parameters value: file %s on line %d\r\n", file, line) */
  /* USER CODE END 6 */
}
#endif /* USE_FULL_ASSERT */

/************************ (C) COPYRIGHT STMicroelectronics *****END OF FILE****/
